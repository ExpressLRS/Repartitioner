#include <stdint.h>
#include <string.h>
#include <freertos/FreeRTOS.h>
#include <freertos/task.h>
#include <esp_spi_flash.h>
#include <esp_ota_ops.h>
#include <esp_err.h>
#include <esp_log.h>

static const char *TAG = "repartitioner";

const uint8_t partition_data[] = {
    0xaa, 0x50, 0x01, 0x02, 0x00, 0x90, 0x00, 0x00, 0x00, 0x50, 0x00, 0x00,
    0x6e, 0x76, 0x73, 0x00, 0x00, 0x00, 0x00, 0x00, 0x00, 0x00, 0x00, 0x00,
    0x00, 0x00, 0x00, 0x00, 0x00, 0x00, 0x00, 0x00, 0xaa, 0x50, 0x01, 0x00,
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    0xff, 0xff, 0xff, 0xff};

uint8_t buffer[0x2000];

void app_main()
{
    vTaskDelay(5000 / portTICK_PERIOD_MS);
    ESP_LOGI(TAG, "Starting...");

    const esp_partition_t *boot_partition = esp_ota_get_running_partition();

    if (boot_partition->size == 0x1E0000)
    {
        ESP_LOGI(TAG, "Partition is correct, setting boot and rebooting...");
        esp_ota_set_boot_partition(esp_ota_get_next_update_partition(NULL));
        esp_restart();
    }

    if (boot_partition->address == 0x10000)
    {
        ESP_LOGI(TAG, "Relocating existing firmware...");

        // We, the repartitioner, are in the first OTA partition, so we have to relocate the partition 2 firmware
        const esp_partition_t *old_partition = esp_ota_get_next_update_partition(NULL);
        int old_location_end = old_partition->address + old_partition->size;
        int new_location_end = 0x1F0000 + old_partition->size;

        while (old_location_end > old_partition->address)
        {
            old_location_end -= 0x2000;
            new_location_end -= 0x2000;
            spi_flash_erase_range(new_location_end, 0x2000);
            spi_flash_read(old_location_end, buffer, 0x2000);
            spi_flash_write(new_location_end, buffer, 0x2000);
        }
    }

    // Write the new partition table
    esp_err_t ret = spi_flash_erase_range(CONFIG_PARTITION_TABLE_OFFSET, 0x1000);
    if (ret == ESP_OK)
    {
        memset(buffer, 0xFF, sizeof(buffer));
        memcpy(buffer, partition_data, sizeof(partition_data));
        spi_flash_write(CONFIG_PARTITION_TABLE_OFFSET, buffer, 0x1000);
    }

    // Set the other partition as boot and reboot
    esp_ota_set_boot_partition(esp_ota_get_next_update_partition(NULL));
    esp_restart();
}